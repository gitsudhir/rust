## esp32-bluetooth/sdkconfig.defaults
```kconfig
CONFIG_BT_ENABLED=y
CONFIG_BT_BLE_ENABLED=y
CONFIG_BT_BLUEDROID_ENABLED=n
CONFIG_BT_NIMBLE_ENABLED=y
CONFIG_BT_NIMBLE_HOST_BASED_PRIVACY=y
CONFIG_BT_NIMBLE_ROLE_OBSERVER=y
CONFIG_BT_NIMBLE_ROLE_BROADCASTER=y
CONFIG_BT_NIMBLE_ROLE_CENTRAL=y
CONFIG_BT_NIMBLE_ROLE_PERIPHERAL=y
CONFIG_BT_NIMBLE_MAX_CONNECTIONS=3
CONFIG_BT_NIMBLE_L2CAP_COC_MAX_NUM=0
CONFIG_BT_NIMBLE_HS_FLOW_CTRL=y
CONFIG_BT_NIMBLE_HS_FLOW_CTRL_ITVL=1
CONFIG_BT_NIMBLE_HS_FLOW_CTRL_THRESH=2
CONFIG_BT_NIMBLE_HS_FLOW_CTRL_TX_ON_DISCONNECT=y
CONFIG_BT_NIMBLE_SM_LEGACY=y
CONFIG_BT_NIMBLE_SM_SC=y
CONFIG_BT_NIMBLE_GAP_DEVICE_NAME="ESP32_BLE"
CONFIG_BT_NIMBLE_GAP_APPEARANCE=0x0
CONFIG_BT_NIMBLE_L2CAP_JOIN_RX_FRAGS=y
CONFIG_BT_NIMBLE_HOST_TASK_STACK_SIZE=4096
CONFIG_BT_NIMBLE_HOST_TASK_PRIORITY=2
CONFIG_BT_NIMBLE_DEBUG=y
```

## esp32-wifi-ultrasonic/sdkconfig.defaults
```kconfig
CONFIG_ESP_WIFI_STATIC_RX_BUFFER_NUM=16
CONFIG_ESP_WIFI_DYNAMIC_RX_BUFFER_NUM=32
CONFIG_ESP_WIFI_DYNAMIC_TX_BUFFER=1
CONFIG_ESP_WIFI_TX_BUFFER_TYPE=1
CONFIG_ESP_WIFI_STATIC_TX_BUFFER_NUM=16
CONFIG_ESP_WIFI_DYNAMIC_TX_BUFFER_NUM=32
CONFIG_ESP_WIFI_AMPDU_TX_ENABLED=1
CONFIG_ESP_WIFI_AMPDU_RX_ENABLED=1
CONFIG_ESP_WIFI_CSI_ENABLED=0
CONFIG_ESP_WIFI_WAPI_PSK_ENABLED=1
CONFIG_ESP_WIFI_FTM_INITIATOR_SUPPORT=1
CONFIG_ESP_WIFI_FTM_RESPONDER_SUPPORT=1
CONFIG_ESP_WIFI_MBO_SUPPORT=1
CONFIG_ESP_WIFI_TWT_INITIATOR_SUPPORT=1
CONFIG_ESP_WIFI_TWT_RESPONDER_SUPPORT=1
CONFIG_ESP_WIFI_SOFTAP_SUPPORT=1
CONFIG_ESP_WIFI_IRAM_OPT=1
CONFIG_ESP_WIFI_RX_IRAM_OPT=1
CONFIG_ESP_WIFI_ENABLE_WPA3_SAE=1
CONFIG_ESP_WIFI_ENABLE_WPA3_SUITEB=1
CONFIG_ESP_WIFI_ENABLE_WAPI=1
```
